## conf/distro/emlinux-k510.conf
```bitbake
require include/emlinux.inc

DISTRO = "emlinux-k510"
DISTRO_FEATURES_append = " kernel-510"
DISTRO_FEATURES_NATIVESDK_append = " kernel-510"

LINUX_GIT_BRANCH ?= "linux-5.10.y-cip"
LINUX_GIT_SRCREV ?= "2a254b6d597775ce6625a742cdfe7fffd699631c"
LINUX_CVE_VERSION ??= "5.10.268"
LINUX_CIP_VERSION ?= "v5.10.268-cip77"
#
# If you want to use latest revision of the kernel, append the following line
# to local.conf
#
#LINUX_GIT_SRCREV = "${LINUX_GIT_BRANCH}"

# preferred providers and versions
require conf/distro/include/emlinux-k510-preferred-provider.inc
```
