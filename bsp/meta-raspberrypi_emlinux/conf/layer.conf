## bsp/meta-raspberrypi_emlinux/conf/layer.conf
```bitbake
# We have a conf and classes directory, add to BBPATH
BBPATH =. "${LAYERDIR}:"

# We have recipes-* directories, add to BBFILES
BBFILES += "${LAYERDIR}/recipes-*/*/*.bb \
            ${LAYERDIR}/recipes-*/*/*.bbappend"

BBFILE_COLLECTIONS += "raspberrypi_emlinux"
BBFILE_PATTERN_raspberrypi_emlinux = "^${LAYERDIR}/"
BBFILE_PRIORITY_raspberrypi_emlinux = "12"

# This should only be incremented on significant changes that will
# cause compatibility issues with other layers
LAYERVERSION_raspberrypi_emlinux = "1"

LAYERDEPENDS_raspberrypi_emlinux = "debian emlinux"

LAYERSERIES_COMPAT_raspberrypi_emlinux = "warrior"
```

## conf/distro/emlinux-bookworm.conf
```bitbake
#
# EMLinux profile
#
# Copyright (c) Cybertrust Japan Co., Ltd. 
#
# Authors:
#  Masami Ichikawa <masami.ichikawa@miraclelinux.com>
#
# SPDX-License-Identifier: MIT
#

require conf/distro/debian-bookworm.conf
require emlinux-common.inc

HOST_DISTRO="emlinux-bookworm"

PREFERRED_VERSION_linux-cip ?= "6.1.%"

DISTRO_CONFIG_SCRIPT = "${LAYERDIR_emlinux}/conf/distro/emlinux-configscript.sh"
```

## conf/distro/emlinux-common.inc
```bitbake
#
# EMLinux distro common file
#
# Copyright (c) Cybertrust Japan Co., Ltd. 
#
# Authors:
#  Masami Ichikawa <masami.ichikawa@miraclelinux.com>
#
# SPDX-License-Identifier: MIT
#

require include/security_flags.inc

INHERIT += "sdk-installer source-info"

DISTRO_KERNELS ?= "linux-cip"
KERNEL_NAME ?= "cip"

PREFERRED_VERSION_linux-cip-native ?= "${PREFERRED_VERSION_linux-cip}"
PREFERRED_VERSION_linux-cip-kbuildtarget ?= "${PREFERRED_VERSION_linux-cip}"

IMAGER_INSTALL:wic = "parted \
  gdisk \
  util-linux \
  dosfstools \
  mtools \
  e2fsprogs \
  python3-setuptools \
  bmap-tools \
  tar \
  fdisk"

IMAGE_PREINSTALL:append = " netbase"

WKS_FILE ?= "${MACHINE}.wks"

SDK_PREINSTALL += " \
  bc \
  libncurses-dev \
  flex \
  bison \
  pkg-config \
  libssl-dev \
  libelf-dev"

SDK_INSTALL += "${@ "linux-headers-"+d.getVar('KERNEL_NAME') if d.getVar('KERNEL_NAME') else '' }"
```

## conf/distro/emlinux-trixie.conf
```bitbake
#
# EMLinux profile
#
# Copyright (c) Cybertrust Japan Co., Ltd.
#
# SPDX-License-Identifier: MIT
#

require conf/distro/debian-trixie.conf
require emlinux-common.inc

HOST_DISTRO="emlinux-trixie"

PREFERRED_VERSION_linux-cip ?= "6.12.%"

DISTRO_CONFIG_SCRIPT = "${LAYERDIR_emlinux}/conf/distro/emlinux-configscript.sh"

DISTRO_APT_SOURCES = "conf/distro/emlinux-trixie.list"
```

## conf/distro/include/emlinux-k510-preferred-provider.inc
```bitbake
# use simple kernel recipes instead of linux-yocto
PREFERRED_PROVIDER_virtual/kernel = "linux-k510"
PREFERRED_PROVIDER_linux-libc-headers = "linux-libc-headers-k510"
PREFERRED_PROVIDER_nativesdk-linux-libc-headers = "nativesdk-linux-libc-headers-k510"
PREFERRED_PROVIDER_virtual/crypt ?= "glibc"
PREFERRED_PROVIDER_virtual/nativesdk-crypt ?= "nativesdk-glibc"
```

## conf/distro/include/security_flags.inc
```bitbake
# 
# Copyright (C) Cybertrust Japan Co., Ltd.
#
# SPDX-License-Identifier: MIT
#
# Following settings are based on 
#    https://git.yoctoproject.org/poky/tree/meta/conf/distro/include/security_flags.inc?h=langdale
#    https://git.yoctoproject.org/poky/tree/meta/conf/bitbake.conf?h=langdale

SELECTED_OPTIMIZATION ?= "-O2"

# _FORTIFY_SOURCE requires -O1 or higher, so disable in debug builds as they use
# -O0 which then results in a compiler warning.
OPTLEVEL = "${@bb.utils.filter('SELECTED_OPTIMIZATION', '-O0 -O1 -O2 -O3 -Ofast -Og -Os -Oz -O', d)}"

lcl_maybe_fortify ?= "${@oe.utils.conditional('OPTLEVEL','-O0','','${OPTLEVEL} -D_FORTIFY_SOURCE=2',d)}"

# Error on use of format strings that represent possible security problems
SECURITY_STRINGFORMAT ?= "-Wformat -Wformat-security -Werror=format-security"

SECURITY_STACK_PROTECTOR ?= "-fstack-protector-strong"
SECURITY_CFLAGS ?= "${SECURITY_STACK_PROTECTOR} ${lcl_maybe_fortify} ${SECURITY_STRINGFORMAT}"

DEBUG_BUILD ?= "1"

CFLAGS ?= "-pipe"
CXXFLAGS ?= "-pipe"

CFLAGS += "${@oe.utils.conditional('DEBUG_BUILD','1',' -g -feliminate-unused-debug-types','',d)}"
CXXFLAGS += "${@oe.utils.conditional('DEBUG_BUILD','1',' -g -feliminate-unused-debug-types','',d)}"

TARGET_CFLAGS = "${SELECTED_OPTIMIZATION} ${CFLAGS}"
TARGET_CXXFLAGS = "${SELECTED_OPTIMIZATION} ${CFLAGS}"

TUNE_CCARGS ?= ""
TARGET_CC_ARCH = "${TUNE_CCARGS} ${SECURITY_CFLAGS}"

TARGET_LINK_HASH_STYLE ?= "${@['-Wl,--hash-style=gnu',''][d.getVar('LINKER_HASH_STYLE') != 'gnu']}"
ASNEEDED ?= "-Wl,--as-needed"
SECURITY_LDFLAGS ?= "-Wl,-z,relro,-z,now"
TARGET_LDFLAGS = "-Wl,-O1 ${TARGET_LINK_HASH_STYLE} ${ASNEEDED} ${SECURITY_LDFLAGS}"

TARGET_AS_ARCH ?= ""
TARGET_LD_ARCH ?= ""
```

## conf/layer.conf
```bitbake
#
# EMLinux layer profile
#
# Copyright (c) Cybertrust Japan Co., Ltd. 
#
# Authors:
#  Masami Ichikawa <masami.ichikawa@miraclelinux.com>
#
# SPDX-License-Identifier: MIT
#

BBPATH .= ":${LAYERDIR}"

BBFILES += "${LAYERDIR}/recipes-*/*/*.bb \
        ${LAYERDIR}/recipes-*/*/*.bbappend"

BBFILE_COLLECTIONS += "emlinux"
BBFILE_PATTERN_emlinux = "^${LAYERDIR}/"
BBFILE_PRIORITY_emlinux = "12"

LAYERSERIES_COMPAT_emlinux = "next"

LAYERDIR_emlinux = "${LAYERDIR}"
```

## conf/machine/beaglebone.conf
```bitbake
#@TYPE: Machine
#@NAME: Beaglebone
#@DESCRIPTION: Machine configuration for Beaglebone

SOC_FAMILY = "ti335x"
TARGET_ARCH = "arm"

DEFAULTTUNE ?= "cortexa8hf-neon"

require conf/machine/include/soc-family.inc
require conf/machine/include/tune-cortexa8.inc

PREFERRED_PROVIDER_virtual/kernel = "linux-base"
KERNEL_IMAGETYPE = "zImage"
KERNEL_DEVICETREE ?= " \
    am335x-boneblack.dtb \
    am335x-boneblack-wireless.dtb \
"

PREFERRED_PROVIDER_virtual/bootloader = "u-boot"
PREFERRED_PROVIDER_u-boot = "u-boot"

SPL_BINARY = "MLO"
UBOOT_SUFFIX = "img"
UBOOT_ENTRYPOINT ?= "0x80008000"
UBOOT_LOADADDRESS ?= "0x80008000"
UBOOT_MACHINE ?= "am335x_boneblack_config"
BOOTENV_SIZE ?= "0x20000"

EXTRA_IMAGEDEPENDS += "u-boot"

SERIAL_CONSOLES ?= "115200;ttyO0"

IMAGE_FSTYPES = "tar.gz wic wic.bmap"
WKS_FILE ?= "beaglebone.wks"

MACHINE_ESSENTIAL_EXTRA_RDEPENDS = "kernel-image kernel-devicetree"

MACHINE_FEATURES = "ext2 serial usbhost vfat"

IMAGE_BOOT_FILES ?= "${KERNEL_IMAGETYPE} ${KERNEL_DEVICETREE}"
```

## conf/machine/generic-x86-64.conf
```bitbake
#
# Generic x86-64 profile
# Copyright (c) Cybertrust Japan Co., Ltd.
#
# Authors:
#  Masami Ichikawa <masami.ichikawa@miraclelinux.com>
#
# SPDX-License-Identifier: MIT
#
DISTRO_ARCH ?= "amd64"

IMAGE_FSTYPES ?= "wic wic.xz"
IMAGER_INSTALL += "${GRUB_BOOTLOADER_INSTALL}"

KERNEL_DEFCONFIG = "generic-x86-64_defconfig"

WKS_FILE ?= "generic-x86-64.wks.in"
```

## conf/machine/qemu-amd64.conf
```bitbake
#
# qemu-amd64  profile
# Copyright (c) Cybertrust Japan Co., Ltd.
#
# Authors:
#  Masami Ichikawa <masami.ichikawa@miraclelinux.com>
#
# SPDX-License-Identifier: MIT
#
DISTRO_ARCH = "amd64"

IMAGE_FSTYPES ?= "ext4"

KERNEL_DEFCONFIG = "qemu-amd64_defconfig"
```

## conf/machine/qemu-arm.conf
```bitbake
#
# qemu-arm  profile
# Copyright (c) Cybertrust Japan Co., Ltd.
#
# SPDX-License-Identifier: MIT
#
DISTRO_ARCH = "armhf"

IMAGE_FSTYPES ?= "ext4"

KERNEL_DEFCONFIG = "qemu-arm_defconfig"
```

## conf/machine/qemu-arm64.conf
```bitbake
#
# qemu-arm64  profile
# Copyright (c) Cybertrust Japan Co., Ltd.
#
# Authors:
#  Masami Ichikawa <masami.ichikawa@miraclelinux.com>
#
# SPDX-License-Identifier: MIT
#
DISTRO_ARCH = "arm64"

IMAGE_FSTYPES ?= "ext4"

KERNEL_DEFCONFIG = "qemu-arm64_defconfig"
```

## conf/machine/raspberrypi-64.inc
```bitbake
# Raspberry Pi profile
# Copyright (c) Cybertrust Japan Co., Ltd.
#
# SPDX-License-Identifier: MIT
#

DISTRO_ARCH ?= "arm64"

# Raspberry Pi needs non-free-firmware repository.
DISTRO_APT_SOURCES:remove = " conf/distro/emlinux-bookworm.list"
DISTRO_APT_SOURCES:prepend = " conf/distro/emlinux-bookworm-full.list "

# wic file settings
IMAGE_FSTYPES ?= "wic wic.xz tar.gz"
WKS_FILE ?= "emlinux-rpi-sdimg.wks.in"

IMAGE_PREINSTALL += "\
  firmware-brcm80211 \
"
IMAGE_INSTALL += "\
  rpi-u-boot-scr \
  rpi-boot-config \
  raspberrypi-bootfiles \
"

IMAGER_INSTALL:wic = "\
  parted \
  dosfstools \
  mtools \
  e2fsprogs \
  bmap-tools \
"

U_BOOT_BIN = "u-boot.bin"

KERNEL_IMAGE = "Image"
```

## conf/machine/raspberrypi3-64.conf
```bitbake
MACHINEOVERRIDES = "raspberrypi3:${MACHINE}"

require conf/machine/include/tune-cortexa53.inc

SERIAL_CONSOLES ?= "115200;ttyS1"

UBOOT_MACHINE ?= "rpi_3_defconfig"
IMAGE_INSTALL_append += " u-boot linux-firmware-bcm43455"

IMAGE_FSTYPES = "tar.gz wic wic.gz"

WKS_FILE ?=  "raspberrypi3-64.wks"
IMAGE_BOOT_FILES ?= "Image \
                     bcm2837-rpi-3-b-plus.dtb \
                     u-boot.bin \
                     rpi-bootfiles/start* \
                     rpi-bootfiles/fixup* \
                     rpi-bootfiles/bootcode.bin;bootcode.bin \
                     rpi-bootfiles/overlays/*;overlays/ \
                     boot.scr \
                     config.txt \
"

do_image_wic[depends] += " \
    rpi-bootfiles:do_deploy \
    rpi-u-boot-scr:do_deploy \
"
```

## conf/machine/raspberrypi3-64.inc
```bitbake
# Raspberry Pi profile
# Copyright (c) Cybertrust Japan Co., Ltd.
#
# SPDX-License-Identifier: MIT
#

DISTRO_ARCH ?= "arm64"

# Raspberry Pi needs non-free-firmware repository.
DISTRO_APT_SOURCES += "conf/distro/emlinux-bookworm-full.list"

# wic file settings
IMAGE_FSTYPES ?= "wic wic.xz"
WKS_FILE ?= "rpi-sdimg"

IMAGE_PREINSTALL += "\
  firmware-brcm80211 \
"
IMAGE_INSTALL += "\
  rpi-u-boot-scr \
  rpi-boot-config \
  raspberrypi-bootfiles \
"

WIC_IMAGER_INSTALL = "\
  parted \
  dosfstools \
  mtools \
  e2fsprogs \
  python3-distutils \
  bmap-tools \
"

KERNEL_DEFCONFIG = "raspberrypi3-64_defconfig"

U_BOOT_BIN = "u-boot.bin"

KERNEL_IMAGE = "Image"

IMAGE_BOOT_FILES ?= "${KERNEL_IMAGE} ${DTB_FILES} \
                     ${IMAGE_ROOTFS}/boot/overlays/*;overlays/ \
                     ${IMAGE_ROOTFS}/usr/lib/u-boot/${MACHINE}/u-boot.bin;./ \
                     ${IMAGE_ROOTFS}/boot/boot.scr;./ \
                     ${IMAGE_ROOTFS}/boot/COPYING.linux;./ \
                     ${IMAGE_ROOTFS}/boot/LICENCE.broadcom;./ \
                     ${IMAGE_ROOTFS}/boot/bootcode.bin;./ \
                     ${IMAGE_ROOTFS}/boot/config.txt;./ \
                     ${IMAGE_ROOTFS}/boot/start.elf;./ \
                     ${IMAGE_ROOTFS}/boot/start_cd.elf;./ \
                     ${IMAGE_ROOTFS}/boot/start_db.elf;./ \
                     ${IMAGE_ROOTFS}/boot/start_x.elf;./ \
                     ${IMAGE_ROOTFS}/boot/fixup.dat;./ \
                     ${IMAGE_ROOTFS}/boot/fixup_cd.dat;./ \
                     ${IMAGE_ROOTFS}/boot/fixup_db.dat;./ \
                     ${IMAGE_ROOTFS}/boot/fixup_x.dat;./"
```

## conf/machine/raspberrypi3bplus-64.conf
```bitbake
# Raspberry Pi profile
# Copyright (c) Cybertrust Japan Co., Ltd.
#
# Authors:
#  Masami Ichikawa <masami.ichikawa@miraclelinux.com>
#
# SPDX-License-Identifier: MIT
#

include conf/machine/raspberrypi3-64.inc

IMAGE_INSTALL += "u-boot-raspberrypi3bplus-64"

PREFERRED_PROVIDER_u-boot-raspberrypi3bplus-64 = "u-boot-raspberrypi3bplus-64"
U_BOOT_CONFIG:raspberrypi3bplus-64 = "rpi_3_b_plus_defconfig"

DTB_FILES = "bcm2837-rpi-3-b-plus.dtb"
```

## conf/machine/raspberrypi4-64.inc
```bitbake
# Raspberry Pi profile
# Copyright (c) Cybertrust Japan Co., Ltd.
#
# SPDX-License-Identifier: MIT
#

include conf/machine/raspberrypi-64.inc

KERNEL_DEFCONFIG = "raspberrypi4-64_defconfig"

IMAGE_BOOT_FILES ?= "${KERNEL_IMAGE} ${DTB_FILES} \
                     ${IMAGE_ROOTFS}/boot/overlays/*;overlays/ \
                     ${IMAGE_ROOTFS}/usr/lib/u-boot/${MACHINE}/u-boot.bin;./ \
                     ${IMAGE_ROOTFS}/boot/boot.scr;./ \
                     ${IMAGE_ROOTFS}/boot/COPYING.linux;./ \
                     ${IMAGE_ROOTFS}/boot/LICENCE.broadcom;./ \
                     ${IMAGE_ROOTFS}/boot/config.txt;./ \
                     ${IMAGE_ROOTFS}/boot/start4.elf;./ \
                     ${IMAGE_ROOTFS}/boot/start4cd.elf;./ \
                     ${IMAGE_ROOTFS}/boot/start4db.elf;./ \
                     ${IMAGE_ROOTFS}/boot/start4x.elf;./ \
                     ${IMAGE_ROOTFS}/boot/fixup4.dat;./ \
                     ${IMAGE_ROOTFS}/boot/fixup4cd.dat;./ \
                     ${IMAGE_ROOTFS}/boot/fixup4db.dat;./ \
                     ${IMAGE_ROOTFS}/boot/fixup4x.dat;./"
```

## conf/machine/raspberrypi4b-64.conf
```bitbake
# Raspberry Pi profile
# Copyright (c) Cybertrust Japan Co., Ltd.
#
# Authors:
#  Hotaka Miyazaki <hotaka.miyazaki@miraclelinux.com>
#
# SPDX-License-Identifier: MIT
#

include conf/machine/raspberrypi4-64.inc

IMAGE_INSTALL += "u-boot-raspberrypi4b-64"

PREFERRED_PROVIDER_u-boot-raspberrypi4b-64 = "u-boot-raspberrypi4-64"
U_BOOT_CONFIG:raspberrypi4b-64 = "rpi_4_defconfig"

DTB_FILES = "bcm2711-rpi-4-b.dtb"
```
